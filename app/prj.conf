## CMakeLists.txt
```
#set(BOARD m5stack_core2/esp32/procpu)
cmake_minimum_required(VERSION 3.20.0)

find_package(Zephyr REQUIRED HINTS $ENV{ZEPHYR_BASE})
project(artemis-lime-trainer)

target_include_directories(app PRIVATE ../libs)
target_sources(app PRIVATE
        ../libs/bt/bluetooth.c
        ../libs/bt/bt_scanner.c
        ../libs/bt/bt_advertiser.c
        #        ../../libs/bt/cli_observer.c
        ../libs/keypad.c
)

file(GLOB IMG_FILES ${PROJECT_SOURCE_DIR}/src/ui/images/*.c)
if (DEFINED MY_UUID)
    target_compile_definitions(app PRIVATE MY_UUID=${MY_UUID})
endif()

target_include_directories(app PRIVATE src)
target_sources(app PRIVATE
        src/fight_ad.c
        src/game_controller.c
        src/ui_controller.c
        src/controller.c
        src/game.c
        src/fight.c
        src/user.c
        src/pokedex.c
        src/main.c

        src/ui/viewer.c
        ${IMG_FILES}
)


#target_sources(app PRIVATE src/event.c)
```

## prj.conf
```kconfig
CONFIG_MAIN_STACK_SIZE=4096

CONFIG_COMMON_LIBC_MALLOC=y
CONFIG_NEWLIB_LIBC=y
CONFIG_NEWLIB_LIBC_FLOAT_PRINTF=y
CONFIG_EVENTS=y
CONFIG_LOG=y


# BLE Peripheral Only, No Encryption
# Core Bluetooth support
CONFIG_BT=y
CONFIG_BT_BROADCASTER=y
CONFIG_BT_OBSERVER=y
CONFIG_BT_EXT_ADV=n
CONFIG_BT_DEVICE_NAME="Core2-Server"

CONFIG_SHELL=y
CONFIG_FPU=y

CONFIG_CBPRINTF_COMPLETE=y
CONFIG_CBPRINTF_FP_SUPPORT=y
CONFIG_LOG_RUNTIME_FILTERING=y
CONFIG_LOG_CMDS=y
CONFIG_LOG_MODE_IMMEDIATE=y

# CONFIG_ASSERT=y

# # Enable Extended Scanning
# CONFIG_BT_EXT_ADV=y
# CONFIG_BT_EXT_SCAN_BUF_SIZE=1650
#
# # Zephyr Bluetooth LE Controller needs 16 event buffers to generate Extended
# # Advertising Report for receiving the complete 1650 bytes of data
# CONFIG_BT_BUF_EVT_RX_COUNT=16
#
# # Set maximum scan data length for Extended Scanning in Bluetooth LE Controller
# CONFIG_BT_CTLR_SCAN_DATA_LEN_MAX=1650
#
# # Increase Zephyr Bluetooth LE Controller Rx buffer to receive complete chain
# # of PDUs
# CONFIG_BT_CTLR_RX_BUFFERS=9
```

## boards/m5stack_core2_procpu.conf
```kconfig
CONFIG_MAIN_STACK_SIZE=4096

# CONFIG_ESP32_USE_UNSUPPORTED_REVISION=y
# CONFIG_BT_SIGNING=n
# CONFIG_BT_SMP=n
# CONFIG_BT_PRIVACY=n
# CONFIG_BT_CTLR_LE_ENC=n

# Display Config
CONFIG_LVGL=y
CONFIG_LV_Z_MEM_POOL_SIZE=24576
CONFIG_LV_Z_SHELL=y
CONFIG_LV_USE_MONKEY=y

CONFIG_DISPLAY=y
CONFIG_INPUT=y

CONFIG_LV_FONT_MONTSERRAT_12=y
CONFIG_LV_FONT_MONTSERRAT_14=y
CONFIG_LV_USE_FONT_COMPRESSED=y

CONFIG_INPUT_FT5336=y
CONFIG_LV_Z_POINTER_INPUT=y
CONFIG_GPIO=y

# # CONFIG_LOG_CMDS=y
CONFIG_MULTITHREADING=y
CONFIG_INPUT_GPIO_KBD_MATRIX=y
CONFIG_INPUT_SHELL=y
CONFIG_INPUT_SHELL_KBD_MATRIX_STATE=y
CONFIG_INPUT_KBD_MATRIX_16_BIT_ROW=y
CONFIG_ESP32_USE_UNSUPPORTED_REVISION=y
# CONFIG_LOG_DEFAULT_LEVEL=4
CONFIG_INPUT_KEYMAP=y
```

## boards/disco_l475_iot1.overlay
```dts
/ {
    ultrasonic1: ultrasonic1 {
        compatible = "hc-sr04";
        status = "okay";
        trigger-gpios = <&gpiob 2 GPIO_ACTIVE_HIGH>;
        echo-gpios = <&gpioa 4 GPIO_ACTIVE_HIGH>;
    };

    ultrasonic2: ultrasonic2 {
        compatible = "hc-sr04";
        status = "okay";
        trigger-gpios = <&gpioa 0 GPIO_ACTIVE_HIGH>;
        echo-gpios = <&gpioa 1 GPIO_ACTIVE_HIGH>;
    };
};
```

## boards/m5stack_core2_procpu.overlay
```dts
#include <zephyr/dt-bindings/input/input-event-codes.h>
#include <zephyr/dt-bindings/input/keymap.h>

/ {
    kbdmatrix: kbdmatrix {
        compatible = "gpio-kbd-matrix";
        status = "okay";
        row-gpios = <&gpio0 19 (GPIO_PULL_UP | GPIO_ACTIVE_LOW)>,  
                    <&gpio0 14 (GPIO_PULL_UP | GPIO_ACTIVE_LOW)>,
                    <&gpio0 26 (GPIO_PULL_UP | GPIO_ACTIVE_LOW)>, 
                    <&gpio0 25 (GPIO_PULL_UP | GPIO_ACTIVE_LOW)>;
        col-gpios = <&gpio0 33 GPIO_ACTIVE_LOW>,
                    <&gpio0 27 GPIO_ACTIVE_LOW>,
                    <&gpio0 32 GPIO_ACTIVE_LOW>,
                    <&gpio0 13 GPIO_ACTIVE_LOW>; 
        settle-time-us = <0>;
        no-ghostkey-check;
    
        keymap {
            compatible = "input-keymap";
            status = "okay";
            keymap = <
            MATRIX_KEY(0, 0, INPUT_KEY_1)
            MATRIX_KEY(0, 1, INPUT_KEY_2)
            MATRIX_KEY(0, 2, INPUT_KEY_3)
            MATRIX_KEY(0, 3, INPUT_KEY_A)
            MATRIX_KEY(1, 0, INPUT_KEY_4)
            MATRIX_KEY(1, 1, INPUT_KEY_5)
            MATRIX_KEY(1, 2, INPUT_KEY_6)
            MATRIX_KEY(1, 3, INPUT_KEY_B)
            MATRIX_KEY(2, 0, INPUT_KEY_7)
            MATRIX_KEY(2, 1, INPUT_KEY_8)
            MATRIX_KEY(2, 2, INPUT_KEY_9)
            MATRIX_KEY(2, 3, INPUT_KEY_C)
            MATRIX_KEY(3, 0, INPUT_KEY_0)
            MATRIX_KEY(3, 1, INPUT_KEY_F)
            MATRIX_KEY(3, 2, INPUT_KEY_E)
            MATRIX_KEY(3, 3, INPUT_KEY_D)
            >;
            row-size = <4>;
            col-size = <4>;
        };
    };
};
```

## src/main.c
```c
//
// Created by Sioryn Willett on 2025-05-18.
//

#include <user.h>
#include <zephyr/kernel.h>
#include <zephyr/shell/shell.h>
#include "controller.h"
#include "fight_ad.h"
#include "game_controller.h"
#include "../../libs/bt/bluetooth.h"
#include "ui/viewer.h"
#include "../../libs/keypad.h"

#include <zephyr/logging/log.h>
LOG_MODULE_REGISTER(app, LOG_LEVEL_DBG);

GameController* game;
InputController input_controller;

int cmd_fight(const struct shell* shell, int argc, char *argv[]) {
    return input_controller.command(shell, argc - 1, argv + 1);
}

SHELL_CMD_REGISTER(fight, NULL, "Start a fight with a nearby player", cmd_fight);
SHELL_CMD_REGISTER(figth, NULL, "Start a fight with a nearby player", cmd_fight);


void pingu(int id) {
    LOG_INF("Pingu: %d", id);
}

int main(void) {
    set_user_name("debbie");
    set_user_fighter(1, (char[]){2, 3, 4, 5});

    if (init_fight_bt()) {
        LOG_ERR("Failed to initialize fight ad");
        return 1;
    }

    game = init_game();
    input_controller = init_input_controller(game);

    if (!register_observer((Observer) {.filter = NULL, .callback = input_controller.observer})) {
        LOG_ERR("Failed to initialise bt input");
        return 2;
    }

    set_user_kp_callback(input_controller.buttonPressed);

    while (true) {
        process_queue();
        int next = update_screen();
        k_msleep(next);
    }
}
```

## src/controller.c
```c
//
// Created by Sioryn Willett on 2025-05-18.
//

#include "controller.h"

#include <pokedex.h>
#include <zephyr/bluetooth/gap.h>
#include <zephyr/random/random.h>

#include "fight_ad.h"
#include "game.h"
#include "user.h"

#include <zephyr/logging/log.h>
LOG_MODULE_DECLARE(app);

GameController *game_controller = NULL;

int wait_cmd(const struct shell *shell, int argc, char **argv) {
    if (argc > 1) {
        LOG_ERR("Usage: fight wait [name]");
        return 1;
    }

    const char* username = argc == 1 ? argv[0] : get_user()->name;
    if (!username) {
        LOG_ERR("Usage: fight wait name");
        return 2;
    }

    set_user_name(username);
    FightAd my_ad = get_fight_ad();

    return game_controller->me.waiting(*my_ad.uuid, *my_ad.sequenceNumber + 1, username);
}

int initiate_cmd(const struct shell *shell, int argc, char **argv) {
    if (!(argc == 1 || argc == 2 || argc == 6)) {
        LOG_ERR("Usage: fight initiate opponent [fighter_id [move_id_1 move_id_2 move_id_3 move_id_4]]");
        return 1;
    }

    Player* opponent = find_player_by_name(get_arena()->players, get_arena()->playerCount, argv[0]);
    if (!opponent) {
        LOG_ERR("Player \"%s\" not found", argv[0]);
        return 2;
    }

    if (argc > 1) {
        int id = get_pokemon_by_name(argv[1])->id;
        if (id != get_user()->fighter.id) {
            set_user_fighter(id, (char[]){0,0,0,0});
        }
    }

    if (argc == 6) {
        for (int i = 0; i < 4; i++) {
            get_user()->fighter.moves[i] = atoi(argv[2 + i]);
        }
    }

    FightAd my_ad = get_fight_ad();

    return game_controller->me.initiate(*my_ad.uuid,
                                        *my_ad.sequenceNumber + 1,
                                        opponent->uuid,
                                        sys_rand32_get(),
                                        get_user()->fighter.id,
                                        get_user()->fighter.moves);
}

int accept_cmd(const struct shell *shell, int argc, char **argv) {
    if (!(argc == 1 || argc == 2 || argc == 6)) {
        LOG_ERR("Usage: fight accept opponent [fighter_id [move_id_1 move_id_2 move_id_3 move_id_4]]");
        return 1;
    }

    Player* challenger = find_player_by_name(get_arena()->pendingPlayers, get_arena()->pendingCount, argv[0]);
    if (!challenger) {
        LOG_ERR("Challenger \"%s\" not found.", argv[0]);
        return 2;
    }

    if (challenger->challengee != *get_fight_ad().uuid) {
        LOG_ERR("Challenger \"%s\" is not challenging us.", challenger->name);
        return 3;
    }

    uint32_t sessionID = challenger->sessionID;

    if (argc > 1) {
        int id = get_pokemon_by_name(argv[1])->id;
        if (id != get_user()->fighter.id) {
            set_user_fighter(id, (char[]){0,0,0,0});
        }
    }

    if (argc == 6) {
        for (int i = 0; i < 4; i++) {
            get_user()->fighter.moves[i] = atoi(argv[2 + i]);
        }
    }

    FightAd my_ad = get_fight_ad();

    return game_controller->me.accept(*my_ad.uuid,
                                        *my_ad.sequenceNumber + 1,
                                        challenger->uuid,
                                        sessionID,
                                        get_user()->fighter.id,
                                        get_user()->fighter.moves);
}

int move_cmd(const struct shell *shell, int argc, char **argv) {
    if (argc != 1) {
        LOG_ERR("Usage: fight move move_id");
        return 1;
    }

    FightAd my_ad = get_fight_ad();
    return game_controller->me.move(*my_ad.uuid, *my_ad.sequenceNumber + 1, *my_ad.sessionID, atoi(argv[0]));
}

int flee_cmd(const struct shell *shell, int argc, char **argv) {
    if (argc != 0) {
        LOG_ERR("Usage: fight flee");
        return 1;
    }

    FightAd my_ad = get_fight_ad();
    return game_controller->me.fled(*my_ad.uuid, *my_ad.sequenceNumber + 1, *my_ad.sessionID);
}

int process_cmd(const struct shell *shell, int argc, char **argv) {
    if (!game_controller) {
        LOG_ERR("Game has not been initialised");
        return 1;
    }

    if (argc < 1) {
        LOG_ERR("Usage: fight command [args]");
        return 2;
    }

    struct {const char* name; int(*cmd)(const struct shell *shell, int argc, char **argv);} commands[] = {
        {"wait", wait_cmd},
        {"initiate", initiate_cmd},
        {"accept", accept_cmd},
        {"move", move_cmd},
        {"flee", flee_cmd},
    };
    for (int i = 0; i < ARRAY_SIZE(commands); i++) {
        if (!strcmp(argv[0], commands[i].name)) {
            return commands[i].cmd(shell, argc - 1, argv + 1);
        }
    }

    LOG_ERR("\"%s\" command not recognised", argv[0]);
    return -1;
}

typedef struct {
    void* reserved;
    const struct shell *shell;
    int argc;
    char** argv;
} CLIMessage;

K_QUEUE_DEFINE(cmd_queue);

int command_observer(const struct shell *shell, int argc, char **argv) {
    CLIMessage* msg = malloc(sizeof(CLIMessage));
    msg->shell = shell;
    msg->argc = argc;
    msg->argv = malloc(sizeof(char*) * argc);
    for (int i = 0; i < argc; i++) {
        msg->argv[i] = malloc(sizeof(char) * strlen(argv[i]) + 1);
        strcpy(msg->argv[i], argv[i]);
    }

    k_queue_append(&cmd_queue, msg);
    return 0;
}

K_QUEUE_DEFINE(button_queue);

void button_pressed(char letter) {
    if (!game_controller) {
        return;
    }

    char* c = malloc(sizeof(void*) + sizeof(char));
    c[sizeof(void*)] = letter;
    k_queue_append(&button_queue, c);
}

void copy_moves(char* out, uint8_t* in) {
    for (int i = 0; i < 4; i++) {
        out[i] = (char) in[i];
    }
}

int fight_ad_process(FightAd ad) {
    PlayerController opponent = game_controller->opponent;
    char moves[4];
    switch (*ad.command) {
        case FC_DONE:
            return 0;
        case FC_WAITING:
            return opponent.waiting(*ad.uuid, *ad.sequenceNumber, (const char *) ad.args);
        case FC_FLEE:
            return opponent.fled(*ad.uuid, *ad.sequenceNumber, *ad.sessionID);
        case FC_INITIATE:
            copy_moves(moves, ad.args + sizeof(uint32_t) + sizeof(uint16_t));
            return opponent.initiate(*ad.uuid,
                                     *ad.sequenceNumber,
                                     *(uint32_t *) ad.args,
                                     *ad.sessionID,
                                     *(uint16_t *) (ad.args + sizeof(uint32_t)),
                                     moves);
        case FC_ACCEPT:
            copy_moves(moves, ad.args + sizeof(uint32_t) + sizeof(uint16_t));
            return opponent.accept(*ad.uuid,
                                   *ad.sequenceNumber,
                                   *(uint32_t *) ad.args,
                                   *ad.sessionID,
                                   *(uint16_t *) (ad.args + sizeof(uint32_t)),
                                   moves);
        case FC_MOVE_0: case FC_MOVE_1: case FC_MOVE_2: case FC_MOVE_3:
            return opponent.move(*ad.uuid, *ad.sequenceNumber, *ad.sessionID, *ad.command - FC_MOVE_0);
        default:
            LOG_ERR("invalid fight ad detected: uuid=0x%x seq=%d session=0x%x cmd=0x%x",
                *ad.uuid, *ad.sequenceNumber, *ad.sessionID, *ad.command);
            return -1;
    }
}

typedef struct {
    void* reserved;
    uint8_t data[32];
    FightAd ad;
} FightAdMessage;

K_QUEUE_DEFINE(bt_queue);

void process_queue(void) {
    while (!k_queue_is_empty(&bt_queue)) {
        FightAdMessage* ad = k_queue_get(&bt_queue, K_MSEC(10));
        if (!ad) {
            return;
        }
        fight_ad_process(ad->ad);
        free(ad);
    }

    while (!k_queue_is_empty(&cmd_queue)) {
        CLIMessage* cmd = k_queue_get(&cmd_queue, K_MSEC(10));
        if (!cmd) {
            return;
        }
        process_cmd(cmd->shell, cmd->argc, cmd->argv);
        for (int i = 0; i < cmd->argc; i++) {
            free(cmd->argv[i]);
        }
        free(cmd->argv);
        free(cmd);
    }

    while (!k_queue_is_empty(&button_queue)) {
        char* c = k_queue_get(&button_queue, K_MSEC(10));
        if (!c) {
            return;
        }

        game_controller->button_pressed(c[sizeof(void*)]);

        free(c);
    }
}

bool arena_observer(const char *mac_addr, int rssi, int type, uint8_t data[], size_t len) {
    if (!game_controller) {
        LOG_ERR("Game has not been initialised");
        return false;
    }

    for (uint8_t i = 0; i < len; i++) {
        uint8_t adLen = data[i++];
        if (adLen == 0) {
            break;
        }

        uint8_t data_type = data[i++];

        if (data_type == BT_DATA_MANUFACTURER_DATA) {
            FightAd fight_ad = parse_fight_ad(data + i, adLen);
            if (!fight_ad.uuid) {
                continue;
            }

            Player* player = find_player_by_uuid(game_controller->arena->players, game_controller->arena->playerCount, *fight_ad.uuid);
            if (player && player->sequenceNumber == *fight_ad.sequenceNumber) {
                return true;
            }

            FightAdMessage* q = malloc(sizeof(FightAdMessage));
            memcpy(q->data, data + i, adLen);
            q->ad = parse_fight_ad(q->data, adLen);
            k_queue_append(&bt_queue, q);
            return true;
        }
    }

    return false;
}

InputController init_input_controller(GameController *controller) {
    game_controller = controller;

    k_queue_init(&bt_queue);
    k_queue_init(&cmd_queue);
    k_queue_init(&button_queue);

    return (InputController){
        .command = command_observer,
        .buttonPressed = button_pressed,
        .observer = arena_observer
    };
}
```

## src/controller.h
```c
//
// Created by Sioryn Willett on 2025-05-18.
//

#ifndef CONTROLLER_H
#define CONTROLLER_H

#include "game_controller.h"
#include <zephyr/shell/shell.h>
#include "../../libs/bt/bt_observer.h"

typedef struct {
    int (*command)(const struct shell* shell, int argc, char** argv);
    void (*buttonPressed)(char letter);
    ObserverCallback observer;
} InputController;

InputController init_input_controller(GameController* controller);

void process_queue(void);

#endif //CONTROLLER_H
```

## src/event.c
```c
//
// Created by Sioryn Willett on 2025-05-27.
//

#include "event.h"
#include <zephyr/kernel.h>

#include <zephyr/shell/shell.h>
#include <zephyr/logging/log.h>

LOG_MODULE_REGISTER(app, LOG_LEVEL_DBG);

K_QUEUE_DEFINE(my_thingo);

int main(void){
    k_queue_init(&my_thingo);

    char bob[] = "some shit";
    LOG_INF("%s", bob);
    // for (int i = 0; i < sizeof(bob) - 1; i++) {
    //     k_queue_append(&my_thingo, bob + i);
    // }

    k_queue_append(&my_thingo, bob);

    while (!k_queue_is_empty(&my_thingo)) {
        char* ad = k_queue_get(&my_thingo, K_MSEC(10));
        if (!ad) {
            return 1;
        }
        LOG_INF("main: (%c)", *ad);
    }

    LOG_INF("%s done!", bob);

    return 0;
}
```

## src/event.h
```c
//
// Created by Sioryn Willett on 2025-05-27.
//

#ifndef EVENT_H
#define EVENT_H

typedef struct {
    int (*callbacks[5])(void*);
    int callbackCount;
    int (*trigger)(void*);
    int (*register_cb)(int(*func)(void*));
} Event;

typedef struct {
  int a;
} Callbacks;

#endif //EVENT_H
```

## src/fight.c
```c
//
// Created by Sioryn Willett on 2025-05-18.
//

#include "fight.h"
```

## src/fight.h
```c
//
// Created by Sioryn Willett on 2025-05-18.
//

#ifndef FIGHT_H
#define FIGHT_H
#include <stdint.h>

typedef struct {
    uint32_t uuid;
    char name[16];
    int sequenceNumber;
    uint32_t challengee;
    uint32_t sessionID;
    int fighter;
    int hp;
    char moves[4];
} Player;

typedef struct {
    Player* players[2];
    uint32_t sessionID;
    Player* winner;
    int moveCount;
    int moves[16];
} Fight;

#endif //FIGHT_H
```

## src/fight_ad.c
```c
//
// Created by Sioryn Willett on 2025-05-14.
//

#include "fight_ad.h"

#include <ctype.h>
#include <stdint.h>
#include <string.h>
#include "../../libs/bt/bluetooth.h"
#include <zephyr/random/random.h>
#include <zephyr/sys/util.h>


#ifndef MY_UUID
#define MY_UUID 0xe1, 0xfd, 0x11, 0xdc
#warning using default UUID
#endif

#include <zephyr/logging/log.h>
LOG_MODULE_REGISTER(fight, LOG_LEVEL_DBG);

static uint8_t fightAdData[] = {
    0xFF, 0xFF, // Vendor (Custom)
    0xDE, 0xAD, // Device Type (Fight game)
    MY_UUID,
    // Session ID
    0x00, 0x00, 0x00, 0x00,
    // Sequence Number
    0x00, 0x00,
    // Command
    0x00, 0x00,
    // Args
    0x00, 0x00, 0x00, 0x00, 0x00, 0x00, 0x00, 0x00, 0x00, 0x00
};

FightAd fightAd;

int init_fight_ad(void) {
    fightAd = parse_fight_ad(fightAdData, ARRAY_SIZE(fightAdData));
    (*fightAd.sessionID) = 0x00000000;
    (*fightAd.command) = FC_DONE;

    if (register_advertisement((Advertisement){
        BT_DATA_MANUFACTURER_DATA,
        fightAdData,
        ARRAY_SIZE(fightAdData)
    })) {
        return 2;
    }


    return 0;
}

int init_fight_bt(void){
    if (init_bt()) {
        return 1;
    }

    return init_fight_ad();
}

int fight_ad_waiting(const char* name) {
    (*fightAd.sequenceNumber)++;
    (*fightAd.command) = FC_WAITING;
    strncpy((char*) fightAd.args, name, 16);

    return !update_advertisements();
}

int fight_ad_initiate(uint32_t opponentUUID, uint32_t sessionID, uint16_t fighter, char moves[]){
    (*fightAd.sessionID) = sessionID;
    (*fightAd.sequenceNumber)++;
    (*fightAd.command) = FC_INITIATE;

    int offset = 0;
    memcpy(fightAd.args + offset, &opponentUUID, sizeof(opponentUUID));
    offset += sizeof(opponentUUID);

    memcpy(fightAd.args + offset, &fighter, sizeof(fighter));
    offset += sizeof(fighter);

    for (int i = 0; i < 4; i++) {
        memcpy(fightAd.args + offset, moves + i, sizeof(moves[0]));
        offset += sizeof(moves[0]);
    }

    return !update_advertisements();
}

int fight_ad_accept(uint32_t opponentUUID, uint32_t sessionID, uint16_t fighter, char moves[]){
    (*fightAd.sessionID) = sessionID;
    (*fightAd.sequenceNumber)++;
    (*fightAd.command) = FC_ACCEPT;

    int offset = 0;
    memcpy(fightAd.args + offset, &opponentUUID, sizeof(opponentUUID));
    offset += sizeof(opponentUUID);

    memcpy(fightAd.args + offset, &fighter, sizeof(fighter));
    offset += sizeof(fighter);

    for (int i = 0; i < 4; i++) {
        memcpy(fightAd.args + offset, moves + i, sizeof(moves[0]));
        offset += sizeof(moves[0]);
    }

    return !update_advertisements();
}

int fight_ad_decline(uint32_t sessionID, uint32_t opponentUUID){
    (*fightAd.sessionID) = sessionID;
    (*fightAd.sequenceNumber)++;
    (*fightAd.command) = FC_WAITING;
    memcpy(fightAd.args, &opponentUUID, sizeof(opponentUUID));

    return !update_advertisements();
}

int fight_ad_move(int move){
    (*fightAd.sequenceNumber)++;
    (*fightAd.command) = FC_MOVE_0 + move;
    return !update_advertisements();
}

int fight_ad_flee(void){
    (*fightAd.sequenceNumber)++;
    (*fightAd.command) = FC_FLEE;

    return !update_advertisements();
}

FightAd parse_fight_ad(uint8_t data[], size_t len) {
#define FIGHT_AD_HEADER_LEN 4
    for (int i = 0; i < FIGHT_AD_HEADER_LEN; i++) {
        if (data[i] != fightAdData[i]) {
            return (FightAd){NULL};
        }
    }
    FightAd fightAd;
    int offset = FIGHT_AD_HEADER_LEN;
    fightAd.uuid = (void*) (data + offset);
    offset += sizeof(*fightAd.uuid);

    fightAd.sessionID = (void*) (data + offset);
    offset += sizeof(*fightAd.sessionID);

    fightAd.sequenceNumber = (void*) (data + offset);
    offset += sizeof(*fightAd.sequenceNumber);

    fightAd.command = (void*) (data + offset);
    offset += sizeof(*fightAd.command);

    fightAd.args = (void*) (data + offset);

    return fightAd;
}

FightAd get_fight_ad(void) {
    return fightAd;
}
```

## src/fight_ad.h
```c
//
// Created by Sioryn Willett on 2025-05-14.
//

#ifndef FIGHT_AD_H
#define FIGHT_AD_H
#include <stddef.h>
#include <stdint.h>

typedef enum {
    FC_WAITING  = 0x00,
    FC_INITIATE = 0x01,
    FC_ACCEPT   = 0x02,
    FC_MOVE_0   = 0x10,
    FC_MOVE_1,
    FC_MOVE_2,
    FC_MOVE_3,
    FC_FLEE     = 0xFF,
    FC_DONE     = 0xD0
} FightCommand;

typedef struct FightAd {
    uint32_t* uuid;
    uint32_t* sessionID;
    uint16_t* sequenceNumber;
    uint16_t* command;
    uint8_t*  args;
} FightAd;

int init_fight_bt(void);

int fight_ad_waiting(const char* name);
int fight_ad_initiate(uint32_t opponentUUID, uint32_t sessionID, uint16_t fighter, char moves[]);
int fight_ad_accept(uint32_t opponentUUID, uint32_t sessionID, uint16_t fighter, char moves[]);
int fight_ad_decline(uint32_t sessionID, uint32_t opponentUUID);
int fight_ad_move(int move);
int fight_ad_flee(void);

FightAd parse_fight_ad(uint8_t data[], size_t len);

FightAd get_fight_ad(void);

#endif //FIGHT_AD_H
```

## src/fight_observer.c
```c
//
// Created by Sioryn Willett on 2025-05-18.
//

#include "fight_observer.h"

#include <zephyr/bluetooth/gap.h>
#include <string.h>
#include <stdlib.h>
#include <stdio.h>
#include <zephyr/shell/shell.h>

#include "fight_ad.h"
#include "fight.h"
#include "game_controller.h"

#include <zephyr/logging/log.h>
LOG_MODULE_DECLARE(fight);

typedef struct {
    int waitingCount;
    Player* waitingPlayers;
    int pendingCount;
    Player* pendingPlayers;
    int fightCount;
    Fight* fights;
} Arena;

Arena arena;

Player* find_player(Player* players, int playerCount, uint32_t uuid) {
    for (int i = 0; i < playerCount; i++) {
        if (players[i].uuid == uuid) {
            return players + i;
        }
    }
    return NULL;
}



Fight* find_fight(Fight* fights, int fightCount, uint32_t sessionID) {
    for (int i = 0; i < fightCount; i++) {
        if (fights[i].sessionID == sessionID) {
            return fights + i;
        }
    }

    return NULL;
}

int register_waiting(FightAd ad) {
    Player* known = find_player(arena.waitingPlayers, arena.waitingCount, *ad.uuid);
    if (!known) {
        arena.waitingPlayers = realloc(arena.waitingPlayers, (arena.waitingCount + 2) * sizeof(Player));
        arena.waitingPlayers[arena.waitingCount] = (Player){
            .uuid = *ad.uuid,
            .sequenceNumber = *ad.sequenceNumber - 1,
        };
        strncpy(arena.waitingPlayers[arena.waitingCount++].name, (char*) ad.args, 16);
        known = find_player(arena.waitingPlayers, arena.waitingCount, *ad.uuid);
    }


    if (known->sequenceNumber != *ad.sequenceNumber) {
        LOG_INF("[%s (%d->%d)]: uuid: 0x%x, session: 0x%x, Waiting to fight!",
            known->name, known->sequenceNumber, *ad.sequenceNumber, known->uuid, *ad.sessionID);
        known->sequenceNumber = *ad.sequenceNumber;
    }

    return 0;
}

Player remove_player_or_create(Player* players, int* playerCount, uint32_t uuid) {
    for (int i = 0; i < *playerCount; i++) {
        if (players[i].uuid == uuid) {
            Player found = players[i];
            players[i] = players[*playerCount - 1];
            *playerCount -= 1;
            return found;
        }
    }

    Player player = {.uuid = uuid};
    strcpy(player.name, "unknown");
    return player;
}

int register_initiate(FightAd ad) {
    Player* known = find_player(arena.pendingPlayers, arena.pendingCount, *ad.uuid);
    if (!known) {
        Player player = remove_player_or_create(arena.waitingPlayers, &arena.waitingCount, *ad.uuid);
        arena.pendingPlayers = realloc(arena.pendingPlayers, (arena.pendingCount + 2) * sizeof(Player));
        arena.pendingPlayers[arena.pendingCount] = player;
        known = arena.pendingPlayers + arena.pendingCount++;
    }

    known->fighter = *(uint16_t*) (ad.args + sizeof(uint32_t));
    memcpy(ad.args + sizeof(uint32_t) + sizeof(uint16_t), known->moves, 4);

    if (known->sequenceNumber != *ad.sequenceNumber) {
        LOG_INF("[%s (%d->%d)]: Initiated a duel (uuid: 0x%x)(session: 0x%x)",
            known->name, known->sequenceNumber, *ad.sequenceNumber, known->uuid, *ad.sessionID);
        known->sequenceNumber = *ad.sequenceNumber;
    }

    return 0;
}

int register_accept(FightAd ad) {
    Fight* fight = find_fight(arena.fights, arena.fightCount, *ad.sessionID);
    if (!fight) {
        Player accepter = remove_player_or_create(arena.waitingPlayers, &arena.waitingCount, *ad.uuid);
        uint32_t sessionID = *ad.sessionID;
        uint32_t opponentUUID = *(uint32_t*) (ad.args);
        accepter.fighter = *(uint16_t*) (ad.args + sizeof(uint32_t));
        memcpy(ad.args + sizeof(uint32_t) + sizeof(uint16_t), accepter.moves, 4);

        // FIXME check the accept matches the initiate
        Player initiater = remove_player_or_create(arena.pendingPlayers, &arena.pendingCount, opponentUUID);
        Fight newFight = {
            .players[0] = initiater,
            .players[1] = accepter,
            .sessionID = *ad.sessionID,
        };
        arena.fights = realloc(arena.fights, (arena.fightCount + 1) * sizeof(Fight));
        arena.fights[arena.fightCount++] = newFight;
    }

    fight = find_fight(arena.fights, arena.fightCount, *ad.sessionID);
    Player* known = fight->players + ((fight->players[0].uuid == *ad.uuid) ? 0 : 1);

    if (known->sequenceNumber != *ad.sequenceNumber) {
        LOG_INF("[%s (%d->%d)]: Accepted a duel (uuid: 0x%x)(session: 0x%x)",
            known->name, known->sequenceNumber, *ad.sequenceNumber, known->uuid, *ad.sessionID);
        known->sequenceNumber = *ad.sequenceNumber;
    }

    return 0;
}

int register_ad(FightAd ad) {
    switch (*ad.command) {
        case FC_WAITING:
            return register_waiting(ad);
        case FC_INITIATE:
            return register_initiate(ad);
        case FC_ACCEPT:
            return register_accept(ad);
        default:
            return -1;
    }
}


bool fight_ad_observe_arena(const char *mac_addr, int rssi, int type, uint8_t data[], size_t len) {
    for (uint8_t i = 0; i < len; i++) {
        uint8_t adLen = data[i++];
        if (adLen == 0) {
            break;
        }

        uint8_t data_type = data[i++];

        if (data_type == BT_DATA_MANUFACTURER_DATA) {
            FightAd fight_ad = parse_fight_ad(data + i, adLen);
            if (!fight_ad.uuid) {
                continue;
            }
            return !register_ad(fight_ad);
        }
    }

    return false;
}

int cmd_list(const struct shell* shell, int argc, char *argv[]) {
    if (!arena.waitingCount) {
        shell_print(shell, "No players waiting");
        return 0;
    }

    for (int i = 0; i < arena.waitingCount; i++) {
        shell_print(shell, "%s: %x", arena.waitingPlayers[i].name, arena.waitingPlayers[i].uuid);
    }
    return 0;
}

SHELL_CMD_ARG_REGISTER(list, NULL, "List fighters waiting", cmd_list, 1, 0);
```

## src/fight_observer.h
```c
//
// Created by Sioryn Willett on 2025-05-18.
//

#ifndef FIGHT_OBSERVER_H
#define FIGHT_OBSERVER_H
#include "../../libs/bt/bt_observer.h"

bool fight_ad_observe_arena(const char* mac_addr, int rssi, int type, uint8_t data[], size_t len);

#endif //FIGHT_OBSERVER_H
```

## src/game.c
```c
//
// Created by Sioryn Willett on 2025-05-19.
//

#include "game.h"
#include "pokedex.h"
#include "fight.h"

#include <zephyr/bluetooth/gap.h>
#include <string.h>
#include <stdlib.h>
#include <stdio.h>
#include <zephyr/shell/shell.h>
#include <zephyr/kernel.h>

#include "fight_ad.h"

#include <zephyr/logging/log.h>
LOG_MODULE_DECLARE(fight);

static Arena arena = {};

Player* find_player_by_name(Player** players, int playerCount, const char* name) {
    long uuid = strtol(name, NULL, 0);
    if (uuid) {
        return find_player_by_uuid(players, playerCount, uuid);
    }

    for (int i = 0; i < playerCount; i++) {
        if (!strcmp(players[i]->name, name)) {
            return players[i];
        }
    }

    return NULL;
}

Player* find_player_by_uuid(Player** players, int playerCount, uint32_t uuid) {
    for (int i = 0; i < playerCount; i++) {
        if (players[i]->uuid == uuid) {
            return players[i];
        }
    }
    return NULL;
}

Player** add_player(Player** players, int* playerCount, Player* player) {
    if (players == NULL || *playerCount >= MAX_PLAYERS) {
        LOG_INF("Failed to allocate memory for players");
        return NULL;
    }

    players[(*playerCount)++] = player;
    return players;
}

Fight* find_fight(Fight* fights, int fightCount, uint32_t sessionID) {
    for (int i = 0; fights && i < fightCount; i++) {
        if (fights[i].sessionID == sessionID) {
            return fights + i;
        }
    }
    return NULL;
}

void remove_player(Player** players, int* playerCount, Player* player) {
    for (int i = 0; i < *playerCount; i++) {
        if (players[i]->uuid == player->uuid) {
            players[i] = players[*playerCount - 1];
            *playerCount -= 1;
            return;
        }
    }
}

Player* find_or_create(uint32_t uuid, uint16_t seq, const char* name) {
    for (int i = 0; i < arena.playerCount; i++) {
        if (arena.players[i]->uuid == uuid) {
            if (name != NULL) {
                strncpy(arena.players[i]->name, name, 16);
            }
            return arena.players[i];
        }
    }

    Player* player = malloc(sizeof(Player));
    if (!player) {
        LOG_ERR("Failed to allocate memory for player");
        return NULL;
    }

    player->uuid = uuid;
    player->sequenceNumber = seq - 1;
    name = name ? name : "<unknown>";
    strncpy(player->name, name, 16);
    add_player(arena.players, &arena.playerCount, player);

    return player;
}

Arena* get_arena(void) {
    return &arena;
}

int register_waiting(uint32_t uuid, uint16_t seq, const char* name) {
    LOG_DBG("register_waiting(uuid=0x%x, seq=%d, name=%s)", uuid, seq, name);

    Player* player = find_or_create(uuid, seq, name);
    if (!player) {
        LOG_ERR("new player couldn't be created");
        return -1;
    }

    if (player->sequenceNumber == seq) {
        return 0;
    }
    uint16_t lastSeq = player->sequenceNumber;
    player->sequenceNumber = seq;

    Player* known = find_player_by_uuid(arena.waitingPlayers, arena.waitingCount, uuid);
    if (!known) {
        add_player(arena.waitingPlayers, &arena.waitingCount, player);
        player->challengee = 0;
        known = find_player_by_uuid(arena.waitingPlayers, arena.waitingCount, uuid);
    }

    if (!known) {
        LOG_ERR("new player couldn't be added to the wait list");
        return -1;
    }

    LOG_INF("[%s (%d->%d)]: uuid: 0x%x, Waiting to fight!",
        known->name, lastSeq, known->sequenceNumber, known->uuid);
    return 1;
}

int register_initiate(uint32_t uuid, uint16_t seq, uint32_t opponentUUID, uint32_t sessionID, int fighter, char moves[4]) {
    LOG_DBG("register_initiate(uuid=0x%x, seq=%d, opponentUUID=0x%x, sessionID=0x%x, fighter=%d, moves=[%d, %d, %d, %d])",
          uuid, seq, opponentUUID, sessionID, fighter, moves[0], moves[1], moves[2], moves[3]);

    Player* player = find_or_create(uuid, seq, NULL);
    if (!player) {
        LOG_ERR("failed to find or create player");
        return -1;
    }

    if (player->sequenceNumber == seq) {
        return 0;
    }
    uint16_t lastSeq = player->sequenceNumber;
    player->sequenceNumber = seq;

    Player* known = find_player_by_uuid(arena.pendingPlayers, arena.pendingCount, uuid);
    if (!known) {
        remove_player(arena.waitingPlayers, &arena.waitingCount, player);
        add_player(arena.pendingPlayers, &arena.pendingCount, player);
        known = find_player_by_uuid(arena.pendingPlayers, arena.pendingCount, uuid);
    }

    if (!known) {
        LOG_ERR("new player couldn't be added to the pending list");
        return -1;
    }

    known->challengee = opponentUUID;
    known->sessionID = sessionID;
    known->fighter = fighter;
    known->hp = get_pokemon(fighter)->maxHP;
    memcpy(known->moves, moves, 4);

    Player* challengee = find_player_by_uuid(arena.waitingPlayers, arena.waitingCount, opponentUUID);
    char* name = challengee ? challengee->name : "<unknown>";

    LOG_INF("[%s (%d->%d)]: Initiated a duel against [%s]",
        known->name, lastSeq, known->sequenceNumber, name);
    return 1;
}

int register_accept(uint32_t uuid, uint16_t seq, uint32_t opponentUUID, uint32_t sessionID, int fighter, char moves[4]) {
    LOG_DBG("register_accept(uuid=0x%x, seq=%d, opponentUUID=0x%x, sessionID=0x%x, fighter=%d, moves=[%d, %d, %d, %d])",
            uuid, seq, opponentUUID, sessionID, fighter, moves[0], moves[1], moves[2], moves[3]);

    Player* player = find_or_create(uuid, seq, NULL);
    if (!player) {
        LOG_ERR("failed to find or create player");
        return -1;
    }

    if (player->sequenceNumber == seq) {
        return 0;
    }
    uint16_t lastSeq = player->sequenceNumber;
    player->sequenceNumber = seq;

    Fight* fight = find_fight(arena.fights, arena.fightCount, sessionID);
    if (!fight) {
        Player* challenger = find_player_by_uuid(arena.pendingPlayers, arena.pendingCount, opponentUUID);
        if (!challenger || (challenger->challengee != uuid)) {
            LOG_ERR("[%s: 0x%x] accepted invalid challenge", player->name, player->uuid);
            player->sequenceNumber = seq;
            return -1;
        }

        remove_player(arena.pendingPlayers, &arena.pendingCount, challenger);
        remove_player(arena.waitingPlayers, &arena.waitingCount, player);

        player->challengee = 0;
        player->fighter = fighter;
        player->hp = get_pokemon(fighter)->maxHP;
        memcpy(player->moves, moves, 4);
        player->sessionID = sessionID;

        Fight newFight = {
            .players[0] = challenger,
            .players[1] = player,
            .sessionID = sessionID,
            .moveCount = 0,
        };
        arena.fights[arena.fightCount++] = newFight;
    }

    LOG_INF("[%s (%d->%d)]: Accepted a duel (uuid: 0x%x)(session: 0x%x)",
        player->name, lastSeq, player->sequenceNumber, player->uuid, sessionID);
    return 1;
}

int calculate_damage(Move* move, Pokemon* attacker, Pokemon* defender) {
    int physicalDamage = (move->power * attacker->power) / defender->defense;
    int specialDamage = (move->specialPower * attacker->specialPower) / defender->specialDefense;
    return physicalDamage + specialDamage;
}

void finalise_fight(Fight* fight, Player* winner) {
    Player* challenger_cpy = malloc(sizeof(Player));
    *challenger_cpy = *fight->players[0];

    Player* challengee_cpy = malloc(sizeof(Player));
    *challengee_cpy = *fight->players[1];

    fight->players[0] = challenger_cpy;
    fight->players[1] = challengee_cpy;
    fight->winner = (winner->uuid == fight->players[0]->uuid) ? challenger_cpy : challengee_cpy;
}

int register_move(uint32_t uuid, uint16_t seq, uint32_t sessionID, int move) {
    LOG_DBG("register_move(uuid=0x%x, seq=%d, sessionID=0x%x, move=%d)",
              uuid, seq, sessionID, move);

    Player* player = find_or_create(uuid, seq, NULL);
    if (!player) {
        LOG_ERR("failed to find or create player");
        return -1;
    }

    if (player->sequenceNumber == seq) {
        return 0;
    }
    player->sequenceNumber = seq;

    Fight* fight = find_fight(arena.fights, arena.fightCount, sessionID);
    if (!fight) {
        LOG_ERR("[%s: 0x%x] fought in an invalid fight", player->name, player->uuid);
        player->sequenceNumber = seq;
        return -2;
    }

    Player* known = find_player_by_uuid(fight->players, 2, uuid);
    if (!known) {
        LOG_ERR("[%s: 0x%x] fought in a fight they weren't in", player->name, player->uuid);
        player->sequenceNumber = seq;
        return -3;
    }

    if (move < 0 || move > 3) {
        LOG_ERR("[%s: 0x%x] invalid move number %d", player->name, player->uuid, move);
        return -4;
    }

    Move* m = get_move(known->moves[move]);
    if (!m->id) {
        LOG_ERR("[%s: 0x%x] invalid move %d", player->name, player->uuid, known->moves[move]);
        return -5;
    }

    fight->moves[fight->moveCount++] = move;
    Player* opponent = (fight->players[0]->uuid == known->uuid) ? fight->players[1] : fight->players[0];
    int damage = calculate_damage(m, get_pokemon(known->fighter), get_pokemon(opponent->fighter));
    opponent->hp -= damage;

    const char* suffix = "";
    if (opponent->hp <= 0) {
        finalise_fight(fight, player);
        suffix = " and killing them";
    }

    LOG_INF("[%s: 0x%x] Performed a %s against [%s: 0x%x] dealing %d damage%s",
        known->name, known->uuid, m->name, opponent->name, opponent->uuid, damage, suffix);
    return 1;
}

int register_fled(uint32_t uuid, uint16_t seq, uint32_t sessionID) {
    LOG_DBG("register_fled(uuid=0x%x, seq=%d, sessionID=0x%x)",
                uuid, seq, sessionID);
    Fight* fight = find_fight(arena.fights, arena.fightCount, sessionID);
    if (!fight) {
        LOG_ERR("Fight not recognised");
        return -1;
    }

    Player* player = find_player_by_uuid(fight->players, 2, uuid);
    if (!player) {
        LOG_ERR("Player not a member of that fight");
        return -2;
    }

    if (player->sequenceNumber == seq) {
        return 0;
    }
    player->sequenceNumber = seq;

    Player* opponent = (player->uuid == fight->players[0]->uuid)
            ? fight->players[1]
            : fight->players[0];

    finalise_fight(fight, opponent);
    LOG_INF("[%s: 0x%x] fled from [%s: 0x%x]",
        player->name, player->uuid, opponent->name, opponent->uuid);
    return 1;
}

void print_waiting(const struct shell* shell) {
    if (!arena.waitingCount) {
        shell_print(shell, "No players waiting");
        return;
    }

    shell_print(shell, "Players waiting:");
    for (int i = 0; i < arena.waitingCount; i++) {
        shell_print(shell, "%s: 0x%x", arena.waitingPlayers[i]->name, arena.waitingPlayers[i]->uuid);
    }
    shell_print(shell, "");
}

void print_challenges(const struct shell* shell) {
    if (!arena.pendingCount) {
        shell_print(shell, "No challenges issued");
        return;
    }

    shell_print(shell, "Challenges issued:");
    for (int i = 0; i < arena.pendingCount; i++) {
        Player* challenger = arena.pendingPlayers[i];
        Player* challengee = find_player_by_uuid(arena.waitingPlayers, arena.waitingCount, challenger->challengee);

        shell_print(shell, "[%s: 0x%x] challenges [%s: 0x%x]\nwith the fighter (%s){%s, %s, %s, %s}",
            challenger->name,
            challenger->uuid,
            challengee ? challengee->name : "<unknown>",
            challenger->challengee,
            get_pokemon(challenger->fighter)->name,
            get_move(challenger->moves[0])->name,
            get_move(challenger->moves[1])->name,
            get_move(challenger->moves[2])->name,
            get_move(challenger->moves[3])->name);
    }
    shell_print(shell, "");
}

void print_fighter(const struct shell* shell, Player* player) {
    Pokemon* p = get_pokemon(player->fighter);
    shell_print(shell, "[%s: 0x%x] with fighter %s (%d/%d){%s, %s, %s, %s}",
            player->name, player->uuid,
            p->name,
            player->hp,
            p->maxHP,
            get_move(player->moves[0])->name,
            get_move(player->moves[1])->name,
            get_move(player->moves[2])->name,
            get_move(player->moves[3])->name);
}

void print_fight(const struct shell* shell, Fight* fight) {
    Player* challenger = fight->players[0];
    Player* challengee = fight->players[1];

    print_fighter(shell, challenger);
    const char* state = (!fight->winner) ? "VS" :
            (fight->winner == challenger) ?
                    "defeated" : "lost to";
    shell_print(shell, "%s", state);
    print_fighter(shell, challengee);
    for (int m = 0; m < fight->moveCount; m++) {
        int fighter_move_number = fight->moves[m];
        char global_move_number = fight->players[m % 2]->moves[fighter_move_number];
        Move* move = get_move(global_move_number);

        shell_fprintf_normal(shell, "%s%s", move->name, m % 2 ? " - " : "|");
    }
    shell_print(shell, "");
}

void print_fights(const struct shell* shell) {
    if (!arena.fightCount) {
        shell_print(shell, "No ongoing fights");
        return;
    }

    shell_print(shell, "Ongoing fights:");
    for (int i = 0; i < arena.fightCount; i++) {
        Fight* fight = arena.fights + i;
        if (!fight->winner) {
            print_fight(shell, fight);
        }
    }

    shell_print(shell, "Finished fights:");
    for (int i = 0; i < arena.fightCount; i++) {
        Fight* fight = arena.fights + i;
        if (fight->winner) {
            print_fight(shell, fight);
        }
    }
}

int cmd_arena(const struct shell* shell, int argc, char *argv[]) {
    print_waiting(shell);
    print_challenges(shell);
    print_fights(shell);
    return 0;
}

SHELL_CMD_REGISTER(arena, NULL, "See the current state of tracked fights and nearby players", cmd_arena);
```

## src/game.h
```c
//
// Created by Sioryn Willett on 2025-05-19.
//

#ifndef GAME_H
#define GAME_H
#include <stdint.h>
#include "fight.h"

#define MAX_PLAYERS 32

typedef struct {
    int playerCount;
    Player* players[MAX_PLAYERS];
    int waitingCount;
    Player* waitingPlayers[MAX_PLAYERS / 2];
    int pendingCount;
    Player* pendingPlayers[MAX_PLAYERS / 2];
    int fightCount;
    Fight fights[MAX_PLAYERS / 4];
} Arena;

Arena* get_arena(void);
Player* find_player_by_name(Player** players, int playerCount, const char* name);
Player* find_player_by_uuid(Player** players, int playerCount, uint32_t uuid);
Fight* find_fight(Fight* fights, int fightCount, uint32_t sessionID);
int register_waiting(uint32_t uuid, uint16_t seq, const char* name);
int register_initiate(uint32_t uuid, uint16_t seq, uint32_t opponentUUID, uint32_t sessionID, int fighter, char moves[4]);
int register_accept(uint32_t uuid, uint16_t seq, uint32_t opponentUUID, uint32_t sessionID, int fighter, char moves[4]);
int register_fled(uint32_t uuid, uint16_t seq, uint32_t sessionID);
int register_move(uint32_t uuid, uint16_t seq, uint32_t sessionID, int i);

#endif //GAME_H
```
