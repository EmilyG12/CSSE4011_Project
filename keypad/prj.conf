## CMakeLists.txt
```
cmake_minimum_required(VERSION 3.20.0)
find_package(Zephyr REQUIRED HINTS $ENV{ZEPHYR_BASE})
project(keypad)

target_sources(app PRIVATE src/keypad.c)
```

## prj.conf
```kconfig
CONFIG_INPUT=y
CONFIG_GPIO=y
# CONFIG_DYNAMIC_THREAD_STACK_SIZE=1024
CONFIG_LOG=y
# CONFIG_LOG_MODE_IMMEDIATE=y
# CONFIG_MAIN_STACK_SIZE=4096
# CONFIG_COMMON_LIBC_MALLOC=y
# CONFIG_NEWLIB_LIBC=y
# CONFIG_NEWLIB_LIBC_FLOAT_PRINTF=y
# CONFIG_EVENTS=y
CONFIG_LOG_CMDS=y
CONFIG_MULTITHREADING=y
CONFIG_INPUT_GPIO_KBD_MATRIX=y
CONFIG_INPUT_SHELL=y
CONFIG_INPUT_SHELL_KBD_MATRIX_STATE=y
CONFIG_INPUT_KBD_MATRIX_16_BIT_ROW=y
CONFIG_ESP32_USE_UNSUPPORTED_REVISION=y
CONFIG_LOG_DEFAULT_LEVEL=3
CONFIG_INPUT_KEYMAP=y
```

## boards/m5stack_core2_procpu.overlay
```dts
#include <zephyr/dt-bindings/input/input-event-codes.h>
#include <zephyr/dt-bindings/input/keymap.h>

/ {
    kbdmatrix: kbdmatrix {
        compatible = "gpio-kbd-matrix";
        status = "okay";
        row-gpios = <&gpio0 19 (GPIO_PULL_UP | GPIO_ACTIVE_LOW)>,  
                    <&gpio0 14 (GPIO_PULL_UP | GPIO_ACTIVE_LOW)>,
                    <&gpio0 26 (GPIO_PULL_UP | GPIO_ACTIVE_LOW)>, 
                    <&gpio0 25 (GPIO_PULL_UP | GPIO_ACTIVE_LOW)>;
        col-gpios = <&gpio0 33 GPIO_ACTIVE_LOW>,
                    <&gpio0 27 GPIO_ACTIVE_LOW>,
                    <&gpio0 32 GPIO_ACTIVE_LOW>,
                    <&gpio0 13  GPIO_ACTIVE_LOW>; 
        settle-time-us = <0>;
        no-ghostkey-check;

    
        keymap {
            compatible = "input-keymap";
            status = "okay";
            keymap = <
            MATRIX_KEY(0, 0, INPUT_KEY_1)
            MATRIX_KEY(0, 1, INPUT_KEY_2)
            MATRIX_KEY(0, 2, INPUT_KEY_3)
            MATRIX_KEY(0, 3, INPUT_KEY_A)
            MATRIX_KEY(1, 0, INPUT_KEY_4)
            MATRIX_KEY(1, 1, INPUT_KEY_5)
            MATRIX_KEY(1, 2, INPUT_KEY_6)
            MATRIX_KEY(1, 3, INPUT_KEY_B)
            MATRIX_KEY(2, 0, INPUT_KEY_7)
            MATRIX_KEY(2, 1, INPUT_KEY_8)
            MATRIX_KEY(2, 2, INPUT_KEY_9)
            MATRIX_KEY(2, 3, INPUT_KEY_C)
            MATRIX_KEY(3, 0, INPUT_KEY_0)
            MATRIX_KEY(3, 1, INPUT_KEY_F)
            MATRIX_KEY(3, 2, INPUT_KEY_E)
            MATRIX_KEY(3, 3, INPUT_KEY_D)
            >;
            row-size = <4>;
            col-size = <4>;
        };
    };
};
```

## src/keypad.c
```c
#ifdef CONFIG_INPUT_KBD_MATRIX 
#include <zephyr/kernel.h>
#include <zephyr/device.h>
#include <zephyr/input/input.h>
#include <zephyr/devicetree.h>
#include <zephyr/drivers/sensor.h>
#include <zephyr/drivers/gpio.h>
#include <zephyr/shell/shell.h>
#include <zephyr/input/input_kbd_matrix.h>
#include <zephyr/dt-bindings/input/keymap.h>
#include <zephyr/input/input_keymap.h>

#define STACK_SIZE 1024
#define THREAD_PRIORITY 7

// k_tid_t thread_id;
// K_THREAD_STACK_DEFINE(kp_stack_area, STACK_SIZE);
// struct k_thread kp_thread_data;

typedef struct {
    size_t x;
    size_t y;
    bool pressed;
} KeypadEvent;

KeypadEvent keypad;

#include <zephyr/logging/log.h>
LOG_MODULE_REGISTER(keypad, LOG_LEVEL_DBG);

static const struct device *const kp_dev = DEVICE_DT_GET(DT_NODELABEL(kbdmatrix));

void (*user_kp_callback)(char letter) = NULL;

char keys[4][4] = {
    {'1', '2', '3', 'A'},
    {'4', '5', '6', 'B'},
    {'7', '8', '9', 'C'},
    {'0', 'F', 'E', 'D'}
};

static void kp_callback(struct input_event *evt, void *user_data)
{  
    char letter = 'K';
    if (evt->code == INPUT_ABS_X) {
        keypad.x = evt->value;
    }
    if (evt->code == INPUT_ABS_Y) {
        keypad.y = evt->value;
    }
    if (evt->code == INPUT_BTN_TOUCH) {
        keypad.pressed = evt->value;
    }
    if (!evt->sync) {
        return;
    }

    if (keypad.pressed && keypad.x != 50 && keypad.y != 50) {
        LOG_DBG("Keypad event: x=%zu, y=%zu, pressed=%d", keypad.x, keypad.y, keypad.pressed);
        for (int i = 0; i < 4; i++) {
            for (int j = 0; j < 4; j++) {
                if (keypad.x == i && keypad.y == j) {
                    letter = keys[j][i];
                    LOG_DBG("Key pressed: %c", letter);
                    break;
                }
            }
        }
        keypad.x = 50;
        keypad.y = 50;
        if (user_kp_callback) {
            user_kp_callback(letter); // Replace 'a' with the actual character based on your logic
        }
    }

}

// This macro registers the callback automatically.
INPUT_CALLBACK_DEFINE(kp_dev, kp_callback, NULL);

#endif // CONFIG_INPUT_KBD_MATRIX

void set_user_kp_callback(void (*callback)(char letter)) {
    #ifdef CONFIG_INPUT_GPIO_KBD_MATRIX
        user_kp_callback = callback;
    #else
        LOG_WRN("No keypad available");
    #endif

}
```
